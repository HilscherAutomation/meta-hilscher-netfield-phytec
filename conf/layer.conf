## conf/machine/include/phytec_common.inc
```bitbake
OEROOT := "${TOPDIR}"

#############################################################################
IMAGE_CLASSES:append = " hilscher_image_types"
IMAGE_FSTYPES += "squashfs wic.bz2 swu licenses.tar.bz2"

#############################################################################
# Kernel
#############################################################################
KERNEL_CLASSES:append = " kernel-fitimage"
KERNEL_IMAGETYPES:append = " fitImage"
PREFERRED_VERSION_linux-imx = "${@bb.utils.contains('MACHINE_FEATURES', 'preempt-rt', '5.15.71-rt', '5.15.71', d)}"

#############################################################################
# Preferred components/settings
#############################################################################
INITRAMFS_IMAGE ?= "core-image-minimal-initramfs"
HILSCHER_RESCUE_IMAGE ??= "hilscher-rescue-image"

#############################################################################
# Keys
#############################################################################
PLATFORM_SIGN ??= "1"

KEYS_DIR .= "${TOPDIR}/keys"
KEYS_IMAGE_SIGN_PRIV ??= "${KEYS_DIR}/debug.key"
KEYS_IMAGE_SIGN_CERT ??= "${KEYS_DIR}/debug.crt"
KEYS_IMAGE_SIGN_CERT_DER ??= "${KEYS_DIR}/debug.crt.der"

FIT_HASH_ALG = "sha256"
FIT_SIGN_ALG = "rsa4096"

#############################################################################
# Bootloader
#############################################################################
UBOOT_SIGN_ENABLE = "1"
UBOOT_SIGN_KEYDIR = "${KEYS_DIR}"
UBOOT_SIGN_KEYNAME = "debug"
UBOOT_MKIMAGE_DTCOPTS = "-I dts -O dtb -p 2000"

#############################################################################
# Contents of boot partition (excluding rootfs)
#############################################################################
IMAGE_BOOT_FILES = " \
    ${IMAGE_BOOTLOADER};boot.bin \
    boot-script-fit/fitImage-boot-menu.scr;boot-fit.scr \
"

#############################################################################
# WIC images
#############################################################################
WIC_IMAGE_DEPENDENCIES:append = " boot-script-fit"
IMAGE_BOOTLOADER = "imx-boot"
WICVARS:append = " IMAGE_BOOTLOADER"
# Use WKS_FILE as it is need by initrd-api-part-cfg
WKS_FILE = "hilscher-gpt-boot-rescue-system-lvm.wks.in"
WKS_FILES:${MACHINE} = "${WKS_FILE}"

WIC_BOOT_PART_CONTENT ??= ""
WIC_RESCUE_PART_CONTENT ??= ""
WIC_SYSTEM_PART_CONTENT ??= ""

#############################################################################
# SWU images
#############################################################################
SWU_SCRIPTS += "swupdate/helper.lua;helper.lua"

SWU_RSYNC_PART_UPDATE ??= "boot system"
SWU_BOOT_PART_CONTENT ??= "${IMAGE_BOOT_FILES}"
SWU_SYSTEM_PART_CONTENT ??= "${IMAGE_LINK_NAME}.squashfs nboot.cfg fitImage"

#############################################################################
# System Partitioning
#############################################################################
# Physical device of system partitions
PHYSICAL_SYSTEM_DEVICE ??= "/dev/mmcblk0 /dev/mmcblk1"
# Size of boot partition
IMAGE_PART_BOOT_SIZE ??= "64M"
# Size of rescue partition
IMAGE_PART_RESCUE_SIZE ??= "128M"
# Size of system partition
IMAGE_PART_SYSTEM_SIZE ??= "1G"
# Size of data partition
IMAGE_PART_DATA_SIZE ??= "max"
# Size of logical volume "data" in userdata partition
PART_DATA_LV_DATA_SIZE ??= "60%VG"
# Size of logical volume "backup" in userdata partition
PART_DATA_LV_BACKUP_SIZE ??= "35%VG"
# Size of logical volume "snapshot" in userdata partition
PART_DATA_LV_SNAPSHOT_SIZE ??= "5%VG"

#############################################################################
# rootfs overlay
#############################################################################
HILSCHER_OVERLAY ??= "/dev/mapper/data-data"
HILSCHER_OVERLAYTARGETS ??= "${NETIOT_OVERLAY_DIRS}"
```

## conf/machine/netfield-phyboard-pollux-imx8mplus.conf
```bitbake
#@TYPE: Machine
#@NAME: NETFIELD PHYBOARD POLLUX iMX8M PLUS
#@DESCRIPTION:
#@PARTNUMBERS:
#@MAINTAINER: Hilscher Gesellschaft fuer Systemautomation mbH
#@TEMPLATECONF: meta-hilscher-netfield-phytec/conf/samples

# specify system device of the target platform, this is required e.g. for the recovery process (deploy target)
PHYSICAL_SYSTEM_DEVICE ?= "/dev/mmcblk1"

#-------------------------------------------------------------------------------
require conf/machine/phyboard-pollux-imx8mp-3.conf
MACHINEOVERRIDES =. "phyboard-pollux-imx8mp-3:"
KERNEL_DEVICETREE = "freescale/imx8mp-phyboard-pollux-rdk.dtb"

BOOTLOADER_SEEK:${MACHINE} = "32"
#-------------------------------------------------------------------------------
require include/phytec_common.inc

PRECONFIGURED_SYSTEM_CONNECTIONS ?= "eth0 eth1"

MACHINE_FEATURES += "pci wifi 3g hab"

# No cifx connected via SPI
CIFX_SPI_CONFIGS = ""

MACHINE_ESSENTIAL_EXTRA_RRECOMMENDS:append = " kernel-module-netanalyzer libnetana netanalyzer-firmware netanalyzer-bsl"
MACHINE_ESSENTIAL_EXTRA_RRECOMMENDS:append = " uionetx"


# Don't install some recommended packages, into rescue image
BAD_RECOMMENDATIONS:pn-hilscher-rescue-image += " \
    kernel-module-netanalyzer libnetana netanalyzer-firmware netanalyzer-bsl \
    kernel-module-uio-netx \
    kernel-5.15* \
"

SWU_FILES += "${IMAGE_BOOTLOADER};boot.bin"
SWU_FILE_ATTRIBUTES += "boot.bin;path=\"/dev/mmcblk0\";offset=\"${BOOTLOADER_SEEK}K\";name=\"boot.bin\";version;install-if-different=true"

# UBOOT_ENTRYPOINT:mx8m-generic-bsp = "0x40800000"
UBOOT_ENTRYPOINT:mx8m-generic-bsp = "0x50800000"
# UBOOT_LOADADDRESS:mx8m-generic-bsp = "0x58000000"
```

## conf/machine/netfield-quantum-rev1.conf
```bitbake
#@TYPE: Machine
#@NAME: netFIELD Quantum Rev.1
#@DESCRIPTION:
#@PARTNUMBERS: 1918.016
#@MAINTAINER: Hilscher Gesellschaft fuer Systemautomation mbH
#@TEMPLATECONF: meta-hilscher-netfield-phytec/conf/samples

PHYSICAL_SYSTEM_DEVICE ?= "/dev/mmcblk1"

#-------------------------------------------------------------------------------
require conf/machine/phyboard-pollux-imx8mp-3.conf
MACHINEOVERRIDES =. "phyboard-pollux-imx8mp-3:"
KERNEL_DEVICETREE = "freescale/netfield-quantum-rev1.dtb"

UBOOT_DTB_NAME = "netfield-quantum-rev1.dtb"

BOOTLOADER_SEEK:${MACHINE} = "32"
#-------------------------------------------------------------------------------
require include/phytec_common.inc

PRECONFIGURED_SYSTEM_CONNECTIONS ?= "eth0 eth1"

MACHINE_FEATURES += "pci wifi 3g hab"
# TODO: MACHINE_FEATURES += "preempt_rt"

# No cifx connected via SPI
CIFX_SPI_CONFIGS = ""

MACHINE_ESSENTIAL_EXTRA_RRECOMMENDS:append = " kernel-module-netanalyzer libnetana netanalyzer-firmware netanalyzer-bsl"
MACHINE_ESSENTIAL_EXTRA_RRECOMMENDS:append = " uionetx"


# Don't install some recommended packages, into rescue image
BAD_RECOMMENDATIONS:pn-hilscher-rescue-image += " \
    kernel-module-netanalyzer libnetana netanalyzer-firmware netanalyzer-bsl \
    kernel-module-uio-netx \
    kernel-5.15* \
"

SWU_FILES += "${IMAGE_BOOTLOADER};boot.bin"
SWU_FILE_ATTRIBUTES += "boot.bin;path=\"/dev/mmcblk1\";offset=\"${BOOTLOADER_SEEK}K\";name=\"boot.bin\";version;install-if-different=true"

# UBOOT_ENTRYPOINT:mx8m-generic-bsp = "0x40800000"
UBOOT_ENTRYPOINT:mx8m-generic-bsp = "0x58000000"
UBOOT_DTB_LOADADDRESS:mx8m-generic-bsp = "0x48000000"
```
